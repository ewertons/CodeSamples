## espressif/esp32/sdcard/sdkconfig.defaults
```kconfig
# FAT filesystem on SD card (long filenames on heap)
CONFIG_FATFS_LFN_MODE_HEAP=y

# Sensible logging
CONFIG_LOG_DEFAULT_LEVEL_INFO=y

# FreeRTOS tick rate
CONFIG_FREERTOS_HZ=1000
```
